/**
 ******************************************************************************
 * @file    serial_test.cpp
 * @authors  lbz
 * @version V1.0.0
 * @date    2014_11_13
 * @brief   
 ******************************************************************************
 */

#include "application.h"

 
/*==================================================================================
名称:Serial.begin
参数:1波特率	2数据位、停止位、奇偶校验
描述:
		通过此接口可初始化串口波特率、数据位位数、停止位、奇偶校验位
===================================================================================*/

/*==================================================================================
名称:Serial.end
参数:
描述:
		注销串口，下次使用需要重新begin
===================================================================================*/

/*==================================================================================
名称:Serial1.print
参数:打印内容
描述:
		通过串口打印字符串以及数字
===================================================================================*/

/*==================================================================================
名称:Serial1.println
参数:打印内容
描述:
		通过串口打印字符串以及数字最后加回车
===================================================================================*/



void setup_Serial1_test_01()
{  

	Serial1.begin(115200);
	
}

void loop_Serial1_test_01()
{  
	static int count_test=0; 
		
	Serial1.println("loop_Serial1_test println");	//println 只是自动添加回车
    	Serial1.print("loop_Serial1_test print");

    	Serial1.print("loop_Serial1_test print\n");
    	
	Serial1.print(count_test);       // 显示十进制
	Serial1.print("\t");    // tab键

	Serial1.print(count_test, DEC);  // 十进制显示
	Serial1.print("\t");    // tab键

	Serial1.print(count_test, HEX);  // 十六进制
	Serial1.print("\t");    // tab键

	Serial1.print(count_test, OCT);  // 显示八进制
	Serial1.print("\t");     // tab键

	Serial1.println(count_test, BIN);  // 显示二进制
	
	count_test++;
	if(count_test==100) count_test=0;

}


/*==================================================================================
名称:while (!Serial)
参数:
描述:
		查询串口初始化是否完成可用了
===================================================================================*/

/*==================================================================================
名称:Serial1.available() 
参数:
返回:缓冲区中可用字节数
描述:
		查询串口获取串口缓冲区中的可用数据字节数
===================================================================================*/

/*==================================================================================
名称:Serial1.parseInt()
参数:
返回:解析到的数字
描述:
		从字符流中解析一个整形数据遇到非数字跳过如果无数据阻塞设置如下
===================================================================================*/

/*==================================================================================
名称:Serial1.setTimeout(system_tick_t timeout)
参数:获取数据等待超时时间ms
描述:
		设置数据流读取等待超时时间
===================================================================================*/

/*
Serial1对应串口3

硬件连接:PC Rx连接串口A2	PC Tx连接串口A3
测试方法:输入三个数字以空格分开按下回车，预期打印输入数字

*/
void setup_Serial1_test_02()
{  

	Serial1.begin(115200);

	 while (!Serial1) {
	    ; // wait for serial port to connect. Needed for Leonardo only
 	 }
//	  Serial1.setTimeout(10*1000) ;		//设置数据流读取等待超时时间

	 Serial1.println("lsetup_Serial1_test_02");	//println 只是自动添加回车
	 Serial1.println("san ge shu zi");

//	 Serial1.write(48);	//0的ascii码是48
	
}



void loop_Serial1_test_02()
{  
	int red,green,blue;
	
	while (Serial1.available() > 0) 	//获取串口缓冲区中的可用数据字节数
	{
	//	Serial1.println("test");
		unsigned char temp;

		red = Serial1.parseInt(); 	//从字符流中解析一个整形数据遇到非数字跳过

		green = Serial1.parseInt(); 

		blue = Serial1.parseInt(); 
		
	
		if ((temp=Serial1.read()) == 13) 	//从串口缓冲区获取一个字节数据unsigned char   13是回车ascii
		{
			Serial1.println(red);
			Serial1.println(green);
			Serial1.println(blue);
		}
		else
		{
			Serial1.println(temp);
		}
	}


}


/*==================================================================================
名称:Serial.find()
参数:
返回:true/flase
描述:
		从串口buffer搜索内容
===================================================================================*/

/*==================================================================================
名称:Serial.findUntil(target, terminal)
参数:
返回:true/flase
描述:
		从串口buffer指定长度内搜索内容
===================================================================================*/




